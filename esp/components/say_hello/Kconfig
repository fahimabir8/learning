## esp/components/say_hello/Kconfig
```kconfig
# create new option in menuconfig

config SAY_HELLO
    bool "Basic print test to console"
    default n
    help 
        Add say_hello() function to print a basic message to console.
```
